## boards/shields/scruffy/Kconfig.defconfig
```kconfig
if SHIELD_SCRUFFY_LEFT

config ZMK_KEYBOARD_NAME
    default "scruffy"

config ZMK_SPLIT_ROLE_CENTRAL
    default y

endif # SHIELD_SCRUFFY_LEFT

if SHIELD_SCRUFFY_LEFT || SHIELD_SCRUFFY_RIGHT

config ZMK_SPLIT
    default y

endif # SHIELD_SCRUFFY_LEFT || SHIELD_SCRUFFY_RIGHT
```

## boards/shields/scruffy/Kconfig.shield
```kconfig
config SHIELD_SCRUFFY_LEFT
    def_bool $(shields_list_contains,scruffy_left)

config SHIELD_SCRUFFY_RIGHT
    def_bool $(shields_list_contains,scruffy_right)
```
